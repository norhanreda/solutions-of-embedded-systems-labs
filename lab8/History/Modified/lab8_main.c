/*
 * Project name:
     lab8.mcpar
 * Generated by:
     Visual TFT
 * Date of creation
     5/7/2023
 * Test configuration:
     MCU:             STM32F407VG
     Dev.Board:       EasyMx_PRO_v7_for_STM32_ARM_9A
     Oscillator:      16000000 Hz
     SW:              mikroC PRO for ARM
                      http://www.mikroe.com/mikroc/arm/
 */

#include "lab8_objects.h"

void main() {
  int cur=0;
  int prev=0;
  int current_screen=1;

  Start_TP();

  GPIO_Digital_Input(&GPIOC_BASE, _GPIO_PINMASK_0);
  GPIO_Digital_Output(&GPIOD_BASE, _GPIO_PINMASK_ALL);

  while (1) {
    Check_TP();

    cur=Button(&GPIOC_IDR, 0, 1, 1);
    if(cur && cur!=prev)
    {
        if (current_screen==1)
        {
         DrawScreen(&Screen2);
         current_screen = 2 ;
        }
        else
        {
         DrawScreen(&Screen1);
         current_screen = 1 ;
        }
    }
    prev=cur;
  }
}
